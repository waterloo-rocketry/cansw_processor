## prj.conf
```kconfig
CONFIG_GPIO=y
CONFIG_STM32_ENABLE_DEBUG_SLEEP_STOP=y
CONFIG_SYS_CLOCK_HW_CYCLES_PER_SEC=500000000


CONFIG_FILE_SYSTEM=y
CONFIG_APP_LINK_WITH_FS=y
CONFIG_FILE_SYSTEM_MAX_TYPES=2
CONFIG_FILE_SYSTEM_MAX_FILE_NAME=-1
CONFIG_FAT_FILESYSTEM_ELM=y


CONFIG_FS_FATFS_MOUNT_MKFS=y
CONFIG_FS_FATFS_MAX_ROOT_ENTRIES=512
CONFIG_FS_FATFS_NUM_FILES=4
CONFIG_FS_FATFS_NUM_DIRS=4
CONFIG_FS_FATFS_CODEPAGE=437
CONFIG_FS_FATFS_MAX_SS=512
CONFIG_FS_FATFS_MIN_SS=512
CONFIG_FS_FATFS_WINDOW_ALIGNMENT=1

CONFIG_DISK_ACCESS=y
CONFIG_DISK_DRIVER_SDMMC=y
CONFIG_SDMMC_STM32=y
CONFIG_SDMMC_STACK=y
CONFIG_SDMMC_VOLUME_NAME="SD"
CONFIG_SDMMC_STM32_CLOCK_CHECK=n
```

## src/main.c
```c
/*
 * Copyright (c) 2019 Tavish Naruka <tavishnaruka@gmail.com>
 * Copyright (c) 2023 Nordic Semiconductor ASA
 * Copyright (c) 2023 Antmicro <www.antmicro.com>
 *
 * SPDX-License-Identifier: Apache-2.0
 */

/* Sample which uses the filesystem API and SDHC driver */

#include <zephyr/kernel.h>
#include <zephyr/device.h>
#include <zephyr/storage/disk_access.h>
#include <zephyr/logging/log.h>
#include <zephyr/fs/fs.h>
#include <zephyr/fs/fs_sys.h>
#include <stdlib.h>


#include <ff.h>

/*
 *  Note the fatfs library is able to mount only strings inside _VOLUME_STRS
 *  in ffconf.h
 */
#define DISK_DRIVE_NAME "SD"
#define DISK_MOUNT_PT "/"DISK_DRIVE_NAME":"
#define MAX_PATH 128

static FATFS fat_fs;


static const char *disk_mount_pt = DISK_MOUNT_PT;

int mountDisk(struct fs_mount_t *mp) {
	// note: make sure mp is static

	printk("Accessing disk...\n");
	if (disk_access_init(DISK_DRIVE_NAME) != 0) {
		printk("Failed to initalize disk access");
		return 1;
	}

	mp->mnt_point = disk_mount_pt;
	mp->type = FS_FATFS;
	mp->fs_data = &fat_fs;

	printk("Attempting to mount disk\n");
	int res = fs_mount(mp);

	switch (res) {
		case -16: 
			printk("Busy. Make sure `mp` is static\n");
			break;
	}

	return res;
}

int testReadDir(const char *path) {
	printk("Testing Read Dir\n");

	struct fs_dir_t dirp;
	fs_dir_t_init(&dirp);

	printk("Opening directory\n");
	int res = fs_opendir(&dirp, path);
	if (res) {
		printk("Error opening dir %s\n [%d]\n", path, res);
		return res;
	}
	printk("Dir opened successfully\n");

	printk("Listing Dir %s ...\n", path);
	int directoryCount = 0;
	for (;; ++directoryCount) {
		struct fs_dirent entry;
		res = fs_readdir(&dirp, &entry);

		if (res || entry.name[0] == 0) {
			break;
		}

		if (entry.type == FS_DIR_ENTRY_DIR) {
			printk("[DIR] %s\n", entry.name);
		} else {
			printk("[FILE] %s (size = %zu)\n", entry.name, entry.size);
		}
	}

	printk("Closing dir\n");

	fs_closedir(&dirp);

	if (res == 0) {
		res = directoryCount;
	}

	printk("Close responded with: %d\n", res);

	return res;
}

int testReadFile(const char *path) {

	struct fs_dirent entry;
	printk("stating file at %s\n", path);
	int res = fs_stat(path, &entry);

	if (res) {
		printk("Failed to stat file\n");
		return res;
	}

	printk("File name: %s | File size: %d\n", entry.name, entry.size);

	printk("Initing file obj\n");
	struct fs_file_t file;
	fs_file_t_init(&file);

	printk("Opening file with read permissions\n");
	res = fs_open(&file, path, FS_O_READ);

	if (res) {
		printk("Open failed\n");
		return res;
	}

	printk("Reading the file with buffer of size %d\n", entry.size + 1);
	char *buffer = (char*) calloc(entry.size + 1, sizeof(char));
	printk("Reading\n");
	res = fs_read(&file, buffer, entry.size);
	if (res < 0) {
		printk("Failed to read file %d\n", res);
		free(buffer);
		return res;
	}

	printk("Result:\n");
	printk("'%s'\n", buffer);

	printk("Freeing buffer\n");
	free(buffer);

	return 0;
}

int testCreateDirectory(const char *path) {
	printk("Making Directory %s\n", path);
	int res = fs_mkdir(path);
	if (res) {
		printk("mkdir failed %d\n", res);

		if (res == -17) {
			printk("The directory already exists\n");
		} else if (res == -2) {
			printk("This seems to mean that the directory name was too long\n");
		}
		return res;
	}

	printk("Directory made successfully\n");
	return 0;

}

int testCreateFile(const char *path) {
	printk("Making a file %s\n", path);

	struct fs_file_t file;
	fs_file_t_init(&file);

	printk("Creating file\n");
	int res = fs_open(&file, path, FS_O_CREATE);
	if (res) {
		printk("Failed to create file %d\n", res);
		return res;
	}

	printk("File created successfully\n");

	printk("closing file\n");
	fs_close(&file);

	return 0;
}

int testWriteFile(const char* path, const char* buffer, const int size) {
	printk("Writing to file %s\n", path);

	struct fs_file_t file;
	fs_file_t_init(&file);

	printk("Opening the file with write permission\n");
	int res = fs_open(&file, path, FS_O_WRITE);
	
	if (res) {
		printk("Failed to open file %d\n", res);
		return res;
	}

	printk("Opened file, writing to it\n");
	res = fs_write(&file, buffer, size);

	if (res < 0) {
		printk("Failed to write to file %d\n", res);
		return res;
	}

	printk("Print succeeded\n");
	printk("Closing file\n");
	fs_close(&file);

	return 0;
}



int main(void) {
	printk("---------------Running test suite---------------\n");

	static struct fs_mount_t mp;
	int res = mountDisk(&mp);

	printk("Mount Responded with: %d\n", res);

	// test
	char *path = (char*) calloc(MAX_PATH, sizeof(char));

	strcat(path, disk_mount_pt);
	strcat(path, "/TOLNG");
	printk("Dir path '%s'\n", path);

	testCreateDirectory(path);

	strcat(path, "/a.txt");
	printk("file path '%s'\n", path);
	testCreateFile(path);

	char *content = "This is some stuff that should go into the file";
	int size = strlen(content);
	printk("trying to write %d bytes '%s' to '%s'\n", size, content, path);
	testWriteFile(path, content, size);

	path[0] = '\0';

	printk("Reading dirs\n");
	strcat(path, disk_mount_pt);
	testReadDir(path);

	strcat(path, "/TOLNG");
	testReadDir(path);

	printk("Reading file\n");
	strcat(path, "/a.txt");
	testReadFile(path);

	path[0] = '\0';
	
	

	printk("Unmounting disk\n");
	fs_unmount(&mp);

	free(path);

	


	while (1) {
		k_sleep(K_MSEC(1000));
	}
	return 0;
}
```

## src/main2.c
```c
/*
 * Copyright (c) 2019 Tavish Naruka <tavishnaruka@gmail.com>
 * Copyright (c) 2023 Nordic Semiconductor ASA
 * Copyright (c) 2023 Antmicro <www.antmicro.com>
 *
 * SPDX-License-Identifier: Apache-2.0
 */

/* Sample which uses the filesystem API and SDHC driver */

#include <zephyr/kernel.h>
#include <zephyr/device.h>
#include <zephyr/storage/disk_access.h>
#include <zephyr/logging/log.h>
#include <zephyr/fs/fs.h>

#if defined(CONFIG_FAT_FILESYSTEM_ELM)

#include <ff.h>

/*
 *  Note the fatfs library is able to mount only strings inside _VOLUME_STRS
 *  in ffconf.h
 */
#define DISK_DRIVE_NAME "SD"
#define DISK_MOUNT_PT "/"DISK_DRIVE_NAME":"

static FATFS fat_fs;
/* mounting info */
static struct fs_mount_t mp = {
	.type = FS_FATFS,
	.fs_data = &fat_fs,
};

#elif defined(CONFIG_FILE_SYSTEM_EXT2)

#include <zephyr/fs/ext2.h>

#define DISK_DRIVE_NAME "SDMMC"
#define DISK_MOUNT_PT "/ext"

static struct fs_mount_t mp = {
	.type = FS_EXT2,
	.flags = FS_MOUNT_FLAG_NO_FORMAT,
	.storage_dev = (void *)DISK_DRIVE_NAME,
	.mnt_point = "/ext",
};

#endif

LOG_MODULE_REGISTER(main);

#define MAX_PATH 128
#define SOME_FILE_NAME "some.dat"
#define SOME_DIR_NAME "some"
#define SOME_REQUIRED_LEN MAX(sizeof(SOME_FILE_NAME), sizeof(SOME_DIR_NAME))

static int lsdir(const char *path);
static bool create_some_entries(const char *base_path)
{
	char path[MAX_PATH];
	struct fs_file_t file;
	int base = strlen(base_path);

	fs_file_t_init(&file);

	if (base >= (sizeof(path) - SOME_REQUIRED_LEN)) {
		LOG_ERR("Not enough concatenation buffer to create file paths");
		return false;
	}

	LOG_INF("Creating some dir entries in %s", base_path);
	strncpy(path, base_path, sizeof(path));

	path[base++] = '/';
	path[base] = 0;
	strcat(&path[base], SOME_FILE_NAME);

	if (fs_open(&file, path, FS_O_CREATE) != 0) {
		LOG_ERR("Failed to create file %s", path);
		return false;
	}
	fs_close(&file);

	path[base] = 0;
	strcat(&path[base], SOME_DIR_NAME);

	if (fs_mkdir(path) != 0) {
		LOG_ERR("Failed to create dir %s", path);
		/* If code gets here, it has at least successes to create the
		 * file so allow function to return true.
		 */
	}
	return true;
}

static const char *disk_mount_pt = DISK_MOUNT_PT;

int main(void)
{
	/* raw disk i/o */
	do {
		static const char *disk_pdrv = DISK_DRIVE_NAME;
		uint64_t memory_size_mb;
		uint32_t block_count;
		uint32_t block_size;

		if (disk_access_init(disk_pdrv) != 0) {
			printk("Catch for debugger");
			LOG_ERR("Storage init ERROR!");
			break;
		}

		if (disk_access_ioctl(disk_pdrv,
				DISK_IOCTL_GET_SECTOR_COUNT, &block_count)) {
			printk("Catch for debugger");
			LOG_ERR("Unable to get sector count");
			break;
		}
		LOG_INF("Block count %u", block_count);

		if (disk_access_ioctl(disk_pdrv,
				DISK_IOCTL_GET_SECTOR_SIZE, &block_size)) {
			LOG_ERR("Unable to get sector size");
			break;
		}
		printk("Sector size %u\n", block_size);

		memory_size_mb = (uint64_t)block_count * block_size;
		printk("Memory Size(MB) %u\n", (uint32_t)(memory_size_mb >> 20));
	} while (0);

	mp.mnt_point = disk_mount_pt;

	int res = fs_mount(&mp);

#if defined(CONFIG_FAT_FILESYSTEM_ELM)
	if (res == FR_OK) {
#else
	if (res == 0) {
#endif
		printk("Disk mounted.\n");
		int return_value = lsdir(disk_mount_pt);
		if (return_value >= 0) {
			if (create_some_entries(disk_mount_pt)) {
				lsdir(disk_mount_pt);
			}
		} else {
			printk("Error listing dir\n");
		}
	} else {
		printk("Error mounting disk.\n");
	}

	fs_unmount(&mp);

	while (1) {
		k_sleep(K_MSEC(1000));
	}
	return 0;
}

/* List dir entry by path
 *
 * @param path Absolute path to list
 *
 * @return Negative errno code on error, number of listed entries on
 *         success.
 */
static int lsdir(const char *path)
{
	int res;
	struct fs_dir_t dirp;
	static struct fs_dirent entry;
	int count = 0;

	fs_dir_t_init(&dirp);

	/* Verify fs_opendir() */
	res = fs_opendir(&dirp, path);
	if (res) {
		printk("Error opening dir %s [%d]\n", path, res);
		return res;
	}

	printk("\nListing dir %s ...\n", path);
	for (;;) {
		/* Verify fs_readdir() */
		res = fs_readdir(&dirp, &entry);

		/* entry.name[0] == 0 means end-of-dir */
		if (res || entry.name[0] == 0) {
			break;
		}

		if (entry.type == FS_DIR_ENTRY_DIR) {
			printk("[DIR ] %s\n", entry.name);
		} else {
			printk("[FILE] %s (size = %zu)\n",
				entry.name, entry.size);
		}
		count++;
	}

	/* Verify fs_closedir() */
	fs_closedir(&dirp);
	if (res == 0) {
		res = count;
	}

	return res;
}
```
