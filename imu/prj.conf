## CMakeLists.txt
```
# SPDX-License-Identifier: Apache-2.0

cmake_minimum_required(VERSION 3.20.0)
find_package(Zephyr REQUIRED HINTS $ENV{ZEPHYR_BASE})
project(blinky)

target_sources(app PRIVATE src/main.c)
target_sources(app PRIVATE src/ICM-20948.c)
target_sources(app PRIVATE src/my2c.c)
```

## prj.conf
```kconfig
CONFIG_GPIO=y
CONFIG_STM32_ENABLE_DEBUG_SLEEP_STOP=y
CONFIG_SYS_CLOCK_HW_CYCLES_PER_SEC=500000000
CONFIG_I2C=y
CONFIG_I2C_STM32=y
```

## src/main.c
```c
/*
 * Copyright (c) 2016 Intel Corporation
 *
 * SPDX-License-Identifier: Apache-2.0
 */

#include <zephyr/kernel.h>
#include <zephyr/drivers/gpio.h>
#include <zephyr/drivers/i2c.h>
#include <zephyr/device.h>
#include "ICM-20948.h"
#include <zephyr/logging/log.h>

/* 1000 msec = 1 sec */
#define SLEEP_TIME_MS 100

#define LED0_NODE DT_ALIAS(led0)
#define I2C4 DT_NODELABEL(i2c4)

static const struct gpio_dt_spec led = GPIO_DT_SPEC_GET(LED0_NODE, gpios);

const struct device *const i2c_dev = DEVICE_DT_GET(I2C4);
uint32_t i2c_cfg = I2C_SPEED_SET(I2C_SPEED_STANDARD) | I2C_MODE_CONTROLLER;

LOG_MODULE_REGISTER(a, LOG_LEVEL_DBG);


int main(void)
{
	//configure I2C

	uint32_t i2c_cfg_tmp;

	if (!device_is_ready(i2c_dev)) {
		
		return 0;
	}

	/* 1. Verify i2c_configure() */
	if (i2c_configure(i2c_dev, i2c_cfg)) {
		
		return 0;
	}

	/* 2. Verify i2c_get_config() */
	if (i2c_get_config(i2c_dev, &i2c_cfg_tmp)) {
		
		return 0;
	}
	if (i2c_cfg != i2c_cfg_tmp) {
		
		return 0;
	}


	//init IMU
	while(!ICM_20948_init(ICM_20948_ADDR, AK09916_MAG_ADDR));
	while(!ICM_20948_check_sanity());

	//blinky init stuff
	int ret;

	if (!gpio_is_ready_dt(&led)) {
		return 0;
	}

	ret = gpio_pin_configure_dt(&led, GPIO_OUTPUT_ACTIVE);
	if (ret < 0) {
		return 0;
	}

	while (1) {
		int16_t data[3];
		//ICM_20948_get_accel_raw(data, data+1, data+2);
		//ICM_20948_get_gyro_raw(data, data+1, data+2);
		ICM_20948_get_mag_raw(data, data+1, data+2);
		printk("x: %d, y: %d, z: %d\n", data[0], data[1], data[2]);

		ret = gpio_pin_toggle_dt(&led);
		if (ret < 0) {
			return 0;
		}
		k_msleep(SLEEP_TIME_MS);
	}

	return 0;
}
```

## src/ICM-20948.c
```c
#include <stdint.h>
#include <stdbool.h>
#include "my2c.h"
#include "ICM-20948.h"  
#include "ICM-20948_regmap.h"

//I2C addresses
static uint8_t ICM_20948_addr;
static uint8_t AK09916_mag_addr;

// This driver assumes that I2C is already initialized
bool ICM_20948_init(uint8_t ICM_20948_addr_in, uint8_t AK09916_mag_addr_in) {
    ICM_20948_addr = ICM_20948_addr_in;
    AK09916_mag_addr = AK09916_mag_addr_in;
    
    // Select user bank 0
    MY2C_write1ByteRegister(ICM_20948_addr, REG_BANK_SEL, 0x00);
    // Wake device and set clock to internal 20 MHz oscillator
    MY2C_write1ByteRegister(ICM_20948_addr, PWR_MGMT_1, 0x06);
    // Enable accelerometer and gyroscope 
    MY2C_write1ByteRegister(ICM_20948_addr, PWR_MGMT_2, 0x00);
    // Set only I2C master to low power mode
    MY2C_write1ByteRegister(ICM_20948_addr, LP_CONFIG, 0b01000000);
    
    // Select user bank 2
    MY2C_write1ByteRegister(ICM_20948_addr, REG_BANK_SEL, 0x20);
    // Set gyroscope full scale to +/-2000dps, rate = 9000 Hz
    MY2C_write1ByteRegister(ICM_20948_addr, GYRO_CONFIG_1, 0x06);
    // Set ODR for gyroscope to 50Hz. ODR = 1100HZ/(1+GYRO_SMPLRT_DIV[7:0])
    MY2C_write1ByteRegister(ICM_20948_addr, GYRO_SMPLRT_DIV, 0x15);
    
    // Set accelerometer full scale to +/- 16g, rate = 4500 Hz
    MY2C_write1ByteRegister(ICM_20948_addr, ACCEL_CONFIG, 0x06);
    // Set ODR for accelerometer to ~49Hz, ODR = 1125Hz/(1+ACCEL_SMPLRT_DIV[11:0])
    MY2C_write1ByteRegister(ICM_20948_addr, ACCEL_SMPLRT_DIV_1, 0x00);
    MY2C_write1ByteRegister(ICM_20948_addr, ACCEL_SMPLRT_DIV_2, 0x16);
    
    // Reset magnetometer
    MY2C_write1ByteRegister(AK09916_mag_addr, CNTL3, 0x01);
    // Set to continuous measurement mode 3 (50 Hz measurement frequency)
    MY2C_write1ByteRegister(AK09916_mag_addr, CNTL2, 0x06);
    //MY2C_write1ByteRegister(AK09916_mag_addr, CNTL2, 0x06);
    
    return true;
}

bool ICM_20948_check_sanity(void) {
    // Select user bank 0
    MY2C_write1ByteRegister(ICM_20948_addr, REG_BANK_SEL, 0x00);
    
    uint8_t addr_sanity = MY2C_read1ByteRegister(ICM_20948_addr, WHO_AM_I);
    uint8_t mag_addr_sanity = MY2C_read1ByteRegister(AK09916_mag_addr, WIA2);
    
    // Sanity fails if the "who am i" registers doesn't match
    //if (addr_sanity != 0xEA || mag_addr_sanity != 0x09) {
    if (addr_sanity != 0xEA) {
        return false;
    }

    // checks pass
    return true;
}

bool ICM_20948_get_accel_raw(int16_t *x, int16_t *y, int16_t *z) {
    if (!x || !y || !z) { return false; }
    
    // Accelerometer measurement data
    uint8_t x_h = MY2C_read1ByteRegister(ICM_20948_addr, ACCEL_XOUT_H);
    uint8_t x_l = MY2C_read1ByteRegister(ICM_20948_addr, ACCEL_XOUT_L);
    *x = (int16_t)((uint16_t)x_h << 8 | x_l);
    
    uint8_t y_h = MY2C_read1ByteRegister(ICM_20948_addr, ACCEL_YOUT_H);
    uint8_t y_l = MY2C_read1ByteRegister(ICM_20948_addr, ACCEL_YOUT_L);
    *y = (int16_t)((uint16_t)y_h << 8 | y_l);

    uint8_t z_h = MY2C_read1ByteRegister(ICM_20948_addr, ACCEL_ZOUT_H);
    uint8_t z_l = MY2C_read1ByteRegister(ICM_20948_addr, ACCEL_ZOUT_L);
    *z = (int16_t)((uint16_t)z_h << 8 | z_l);

    return true; 
}

bool ICM_20948_get_gyro_raw(int16_t *x, int16_t *y, int16_t *z) {
    if (!x || !y || !z) { return false; }
    
    uint8_t x_h = MY2C_read1ByteRegister(ICM_20948_addr, GYRO_XOUT_H);
    uint8_t x_l = MY2C_read1ByteRegister(ICM_20948_addr, GYRO_XOUT_L);
    *x = (int16_t)((uint16_t)x_h << 8 | x_l);

    uint8_t y_h = MY2C_read1ByteRegister(ICM_20948_addr, GYRO_YOUT_H);
    uint8_t y_l = MY2C_read1ByteRegister(ICM_20948_addr, GYRO_YOUT_L);
    *y = (int16_t)((uint16_t)y_h << 8 | y_l);

    uint8_t z_h = MY2C_read1ByteRegister(ICM_20948_addr, GYRO_ZOUT_H);
    uint8_t z_l = MY2C_read1ByteRegister(ICM_20948_addr, GYRO_ZOUT_L);
    *z = (int16_t)((uint16_t)z_h << 8 | z_l);

    return true;
}

bool ICM_20948_get_mag_raw(int16_t *x, int16_t *y, int16_t *z) {
    if (!x || !y || !z) { return false; }
    
     // Check if magnetometer data is ready, fail if it is not
    uint8_t mag_data_status_1 = MY2C_read1ByteRegister(AK09916_mag_addr, ST1);
    
    if (mag_data_status_1 != 0x0) {
        return false;
    }
    
    uint8_t x_h = MY2C_read1ByteRegister(AK09916_mag_addr, HXH);
    uint8_t x_l = MY2C_read1ByteRegister(AK09916_mag_addr, HXL);
    *x = (int16_t)((uint16_t)x_h << 8 | x_l);

    uint8_t y_h = MY2C_read1ByteRegister(AK09916_mag_addr, HYH);
    uint8_t y_l = MY2C_read1ByteRegister(AK09916_mag_addr, HYL);
    *y = (int16_t)((uint16_t)y_h << 8 | y_l);

    uint8_t z_h = MY2C_read1ByteRegister(AK09916_mag_addr, HZH);
    uint8_t z_l = MY2C_read1ByteRegister(AK09916_mag_addr, HZL);
    *z = (int16_t)((uint16_t)z_h << 8 | z_l);

    // Must read ST2 register after measurement, see datasheet register 13.4 ST2
    MY2C_read1ByteRegister(AK09916_mag_addr, ST2);
    
    return true;
}

//IMU has a temperature sensor, it is not being used

//bool ICM_20948_get_temp_raw(int16_t *temp) {
//    uint8_t t_h = MY2C_read1ByteRegister(ICM_20948_addr, TEMP_OUT_H);
//    uint8_t t_l = MY2C_read1ByteRegister(ICM_20948_addr, TEMP_OUT_L);
//    *temp = (int16_t)((uint16_t)t_h << 8 | t_l);
// }
```

## src/ICM-20948.h
```c
#ifndef ICM_20948_H
#define	ICM_20948_H

#define ICM_20948_ADDR 0x69
#define AK09916_MAG_ADDR 0x0C

#include <stdint.h>
#include <stdbool.h>

// Set up gyroscope, accelerometer, and magnetometer
bool ICM_20948_init(uint8_t ICM_20948_addr_in, uint8_t AK09916_mag_addr_in);

// Check if the device is alive. Fails if an I2C can't be established
// or if WHO_AM_I registers don't return default values.

bool ICM_20948_check_sanity(void);

// Get IMU data: accelerometer, gyroscope, magnetometer, and temperature

bool ICM_20948_get_accel_raw(int16_t *x, int16_t *y, int16_t *z);

bool ICM_20948_get_gyro_raw(int16_t *x, int16_t *y, int16_t *z);

bool ICM_20948_get_mag_raw(int16_t *x, int16_t *y, int16_t *z);

bool ICM_20948_get_temp_raw(int16_t *temp);

bool ICM_20948_get_temp(int16_t *temp);  

#endif	/* ICM_20948_H */
```

## src/ICM-20948_regmap.h
```c
#ifndef ICM_20948_REG_H
#define ICM_20948_REG_H


#define REG_BANK_SEL 0x7F // select user bank 0, 1, 2, or 3

// User bank 0 register map
#define WHO_AM_I 0x00 // returns 0xEA for ICM-20948
#define USER_CTRL 0x03
#define LP_CONFIG 0x05

#define PWR_MGMT_1 0x06
#define PWR_MGMT_2 0x07

#define INT_PIN_CFG 0x0F
#define INT_ENABLE 0x10
#define INT_ENABLE_1 0x11
#define INT_ENABLE_2 0x12
#define INT_ENABLE_3 0x13
#define I2C_MST_STATUS 0x17
#define INT_STATUS 0x19
#define INT_STATUS_1 0x1A
#define INT_STATUS_2 0x1B
#define INT_STATUS_3 0x1C

#define DELAY_TIMEH 0x28
#define DELAY_TIMEL 0x29

#define ACCEL_XOUT_H 0x2D
#define ACCEL_XOUT_L 0x2E
#define ACCEL_YOUT_H 0x2F
#define ACCEL_YOUT_L 0x30
#define ACCEL_ZOUT_H 0x31
#define ACCEL_ZOUT_L 0x32

#define GYRO_XOUT_H 0x33
#define GYRO_XOUT_L 0x34
#define GYRO_YOUT_H 0x35
#define GYRO_YOUT_L 0x36
#define GYRO_ZOUT_H 0x37
#define GYRO_ZOUT_L 0x38

#define TEMP_OUT_H 0x39
#define TEMP_OUT_L 0x3A

#define EXT_SLV_SENS_DATA_00 0x3B
#define EXT_SLV_SENS_DATA_01 0x3C
#define EXT_SLV_SENS_DATA_02 0x3D
#define EXT_SLV_SENS_DATA_03 0x3E
#define EXT_SLV_SENS_DATA_04 0x3F
#define EXT_SLV_SENS_DATA_05 0x40
#define EXT_SLV_SENS_DATA_06 0x41
#define EXT_SLV_SENS_DATA_07 0x42
#define EXT_SLV_SENS_DATA_08 0x43
#define EXT_SLV_SENS_DATA_09 0x44
#define EXT_SLV_SENS_DATA_10 0x45
#define EXT_SLV_SENS_DATA_11 0x46
#define EXT_SLV_SENS_DATA_12 0x47
#define EXT_SLV_SENS_DATA_13 0x48
#define EXT_SLV_SENS_DATA_14 0x49
#define EXT_SLV_SENS_DATA_15 0x4A
#define EXT_SLV_SENS_DATA_16 0x4B
#define EXT_SLV_SENS_DATA_17 0x4C
#define EXT_SLV_SENS_DATA_18 0x4D
#define EXT_SLV_SENS_DATA_19 0x4E
#define EXT_SLV_SENS_DATA_20 0x4F
#define EXT_SLV_SENS_DATA_21 0x50
#define EXT_SLV_SENS_DATA_22 0x51
#define EXT_SLV_SENS_DATA_23 0x52

#define FIFO_EN_1 0x66
#define FIFO_EN_2 0x67
#define FIFO_RST 0x68
#define FIFO_MODE 0x69
#define FIFO_COUNTH 0x70
#define FIFO_COUNTL 0x71
#define FIFO_R_W 0x72
#define DATA_RDY_STATUS 0x74
#define FIFO_CFG 0x76

// User bank 1 register map
#define SELF_TEST_X_GYRO 0x02
#define SELF_TEST_Y_GYRO 0x03
#define SELF_TEST_Z_GYRO 0x04
#define SELF_TEST_X_ACCEL 0x0E
#define SELF_TEST_Y_ACCEL 0x0F
#define SELF_TEST_Z_ACCEL 0x10

#define XA_OFFS_H 0x14
#define XA_OFFS_L 0x15

#define YA_OFFS_H 0x17
#define YA_OFFS_L 0x18

#define ZA_OFFS_H 0x1A
#define ZA_OFFS_L 0x1B

#define TIMEBASE_CORRECTION_PLL 0x28

// User bank 2 register map
#define GYRO_SMPLRT_DIV 0x00
#define GYRO_CONFIG_1 0x01
#define GYRO_CONFIG_2 0x02

#define XG_OFFS_USRH 0x03
#define XG_OFFS_USRL 0x04

#define YG_OFFS_USRH 0x05
#define YG_OFFS_USRL 0x06

#define ZG_OFFS_USRH 0x07
//#define ZG_OFFS_USRL 0x08

#define ODR_ALIGN_EN 0x09
#define ACCEL_SMPLRT_DIV_1 0x10
#define ACCEL_SMPLRT_DIV_2 0x11
#define ACCEL_INTEL_CTRL 0x12
#define ACCEL_WOM_THR 0x13
#define ACCEL_CONFIG 0x14
#define ACCEL_CONFIG_2 0x15
#define FSYNC_CONFIG 0x52
#define TEMP_CONFIG 0x53
#define MOD_CTRL_USR 0x54

// User bank 3 register map
#define I2C_MST_ODR_CONFIG 0x00
#define I2C_MST_CTRL 0x01
#define I2C_MST_DELAY_CTRL 0x02
#define I2C_SLV0_ADDR 0x03
#define I2C_SLV0_REG 0x04
#define I2C_SLV0_CTRL 0x05
#define I2C_SLV0_DO 0x06
#define I2C_SLV1_ADDR 0x07
#define I2C_SLV1_REG 0x08
#define I2C_SLV1_CTRL 0x09
#define I2C_SLV1_DO 0x0A
#define I2C_SLV2_ADDR 0x0B
#define I2C_SLV2_REG 0x0C
#define I2C_SLV2_CTRL 0x0D
#define I2C_SLV2_DO 0x0E
#define I2C_SLV3_ADDR 0x0F
#define I2C_SLV3_REG 0x10
#define I2C_SLV3_CTRL 0x11
#define I2C_SLV3_DO 0x12
#define I2C_SLV4_ADDR 0x13
#define I2C_SLV4_REG 0x14
#define I2C_SLV4_CTRL 0x15
#define I2C_SLV4_DO 0x16
#define I2C_SLV4_DI 0x17

// Magnetometer register map
#define WIA2 0x01
#define ST1 0x10
#define HXL 0x11
#define HXH 0x12
#define HYL 0x13
#define HYH 0x14
#define HZL 0x15
#define HZH 0x16
#define ST2 0x18

#define CNTL2 0x31
#define CNTL3 0x32

#endif
```

## src/my2c.c
```c
#include <stdbool.h>
#include "my2c.h"

#include <zephyr/kernel.h>
#include <zephyr/drivers/i2c.h>
#include <zephyr/device.h>

extern const struct device *const i2c_dev;

bool MY2C_write(uint8_t address, uint8_t *data, uint8_t len) {
   return i2c_write(i2c_dev, data, len, address);
}

bool MY2C_read(uint8_t address, uint8_t *data, uint8_t len) {
    return i2c_read(i2c_dev, data, len, address);
}

bool MY2C_writeCmd(uint8_t address, uint8_t cmd) {
    return MY2C_write(address, &cmd, 1);
}

void MY2C_readNByteRegister(uint8_t address, uint8_t reg, uint8_t *data, uint8_t len) {
    MY2C_write(address, &reg, 1);
    MY2C_read(address, data, len);
}

bool MY2C_write1ByteRegister(uint8_t address, uint8_t reg, uint8_t val) {
    uint8_t data[2] = {reg, val};
    return MY2C_write(address, data, 2);
}

uint8_t MY2C_read1ByteRegister(uint8_t address, uint8_t reg) {
    uint8_t data;
    MY2C_readNByteRegister(address, reg, &data, 1);
    return data;
}

uint16_t MY2C_read2ByteRegister(uint8_t address, uint8_t reg) {
    MY2C_write(address, &reg, 1);
    uint8_t data[2];
    MY2C_read(address, data, 2);
    return (uint16_t)(data[0]) << 8 | data[1];
}
```

## src/my2c.h
```c
#ifndef MY2C_H
#define	MY2C_H

#ifdef	__cplusplus
extern "C" {
#endif
    
#include <stdint.h>
#include <stdbool.h>

bool MY2C_write(uint8_t address, uint8_t *data, uint8_t len);

bool MY2C_read(uint8_t address, uint8_t *data, uint8_t len);

bool MY2C_writeCmd(uint8_t address, uint8_t cmd);

void MY2C_readNByteRegister(uint8_t address, uint8_t reg, uint8_t *data, uint8_t len);

bool MY2C_write1ByteRegister(uint8_t address, uint8_t reg, uint8_t val);

uint8_t MY2C_read1ByteRegister(uint8_t address, uint8_t reg);

uint16_t MY2C_read2ByteRegister(uint8_t address, uint8_t reg);

#ifdef	__cplusplus
}
#endif

#endif	/* MY2C_H */
```
