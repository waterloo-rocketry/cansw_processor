## boards/arm/processor/Kconfig.board
```kconfig
config SOC_STM32H733XX
	bool "STM32H733XX"
	select CPU_CORTEX_M7
	select CPU_HAS_FPU_DOUBLE_PRECISION

config BOARD_PROCESSOR
	bool "processor board"
	depends on SOC_STM32H733XX
```

## soc/arm/st_stm32/stm32h7/Kconfig.defconfig.stm32h733xx
```kconfig
# ST STM32H723X MCU configuration options

if SOC_STM32H733XX

config SOC
	default "stm32h733xx"

config NUM_IRQS
	default 163

endif # SOC_STM32H733XX
```

## soc/arm/st_stm32/stm32h7/Kconfig.soc
```kconfig
# ST Microelectronics STM32H7 MCU line

# Copyright (c) 2019 Linaro Limited
# Copyright (c) 2020 Teslabs Engineering S.L.
# Copyright (c) 2021 Electrolance Solutions
# SPDX-License-Identifier: Apache-2.0


choice
	prompt "STM32H7x MCU Selection"
	depends on SOC_SERIES_STM32H7X

config SOC_STM32H733XX
	bool "STM32H733XX"
	select CPU_CORTEX_M7
	select CPU_HAS_FPU_DOUBLE_PRECISION


endchoice
```

## twister-out/processor/samples/userspace/prod_consumer/sample.userspace.prod_consumer/Kconfig/Kconfig.shield
```kconfig
osource "C:/Users/joedo/zephyrproject/cansw_processor/boards/shields/*/Kconfig.shield"
```
